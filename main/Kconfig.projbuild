## main/Kconfig.projbuild
```kconfig
menu "heating_controller Configuration"

config ONE_WIRE_GPIO
    int "OneWire GPIO number"
	range 0 34
	default 16
	help
		GPIO number (IOxx) to access One Wire Bus.

		Some GPIOs are used for other purposes (flash connections, etc.) and cannot be used.

		GPIOs 35-39 are input-only so cannot be used to drive the One Wire Bus.
config RELAIS1_GPIO
    int "RELAIS1 GPIO number"
	range 0 34
	default 25
config RELAIS2_GPIO
    int "RELAIS2 GPIO number"
	range 0 34
	default 26
config PWM_IN_GPIO
    int "PWM In GPIO number"
	range 0 34
	default 22
config PWM_OUT_GPIO
    int "PWM Out GPIO number"
	range 0 34
	default 23

config WIFI_SSID
    string "WIFI SSID"
config WIFI_PASSWORD
    string "WIFI Password"

config MQTT_SERVER
    string "MQTT Server (IP)"
config MQTT_PORT
    int "MQTT Port"
    default 1883
config MQTT_ID
    string "MQTT Client ID"
config MQTT_USER
    string "MQTT User"
config MQTT_PASSWORD
    string "MQTT Passowrd"

config inflow_floor_heating_sensor
	string "In Flow Floor Heating Sensor Rom Code"
config returnflow_floor_heating_sensor
	string "Return Flow Floor Heating Sensor Rom Code"
config inflow_heater_sensor
	string "In Flow Header Sensor Rom Code"
config returnflow_heater_sensor
	string "Return Flow Heater Sensor Rom Code"
	
config controller_hysteresis
	int "Controller Hysteresis (°C)"
	default 2
config controller_emergency_value
	int "Controller Emergency Value (°C)"
	default 50
config controller_max_value
	int "Controller Actuator Turn time (s)"
	default 140
config controller_set_point
	int "Controller Start Set Point (°C)"
	default 25
config controller_reaction_time
	int "Controller Reaction Time (s)"
	default 60
config controller_step_time
	int "Controller Step Time (s)"
	default 10

config REMOTELOG_UDP_HOST
    string "Remote Log UDP hostname"
config REMOTELOG_UDP_PORT
    int "Remote Log UDP Port"
    default 12345
config REMOTELOG_SYSLOG_HOST
    string "Remote Log Syslog hostname"
config REMOTELOG_SYSLOG_PORT
    int "Remote Log Syslog Port"
    default 514
config REMOTELOG_SYSLOG_APP
    string "Remote Log Syslog application"
    default "heating-controller"
endmenu
```
